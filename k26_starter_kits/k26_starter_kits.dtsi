// SPDX-License-Identifier: GPL-2.0
/*
 * dts file for Xilinx K26 starter kits
 *
 * (C) Copyright 2020 - 2021, Xilinx, Inc.
 *
 */

/dts-v1/;
/plugin/;

&fpga_full {
	#address-cells = <2>;
	#size-cells = <2>;
	firmware-name = "k26_starter_kits.bit.bin";
	resets = <&zynqmp_reset 116>, <&zynqmp_reset 117>, <&zynqmp_reset 118>, <&zynqmp_reset 119>;
};
