// SPDX-License-Identifier: GPL-2.0
/*
 * dts file for Xilinx K24 starter kits
 *
 * Copyright (C) 2022, Advanced Micro Devices, Inc.
 *
 */

/dts-v1/;
/plugin/;

&fpga_full {
	#address-cells = <2>;
	#size-cells = <2>;
	firmware-name = "k24-starter-kits.bit.bin";
	resets = <&zynqmp_reset 116>, <&zynqmp_reset 117>, <&zynqmp_reset 118>, <&zynqmp_reset 119>;
};
